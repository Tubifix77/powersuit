## firmware/apps/node_helmet/main/Kconfig.projbuild
```kconfig
menu "Powersuit node_helmet Configuration"

    choice PS_WAKE_ENGINE
        prompt "Wake-word / VOX engine"
        default PS_WAKE_ENERGY_GATE
        help
            Selects what decides when the mic uplink starts streaming
            (docs/safety.md §6). The energy-gate path is the default and must
            build without esp-sr present (it is not a default dependency,
            see main/idf_component.yml); esp-sr is an explicit opt-in for
            boards that have vendored it and populated the "model" partition
            (partitions.csv).

        config PS_WAKE_ENERGY_GATE
            bool "Energy gate (ps_egate, pure C, no model)"
            help
                RMS-over-window VOX gate from ps_audio: opens the uplink on
                any sound above threshold. No wake word, no model, always
                available.

        config PS_WAKE_ESP_SR
            bool "esp-sr wake word (WakeNet)"
            help
                NOT IMPLEMENTED. The option and the reserved "model" flash
                partition exist, but no WakeNet integration has been written.
                Selecting this fails the build with an #error explaining what
                is missing, rather than quietly falling back to the energy
                gate. Implementing it means adding espressif/esp-sr to
                main/idf_component.yml, flashing a model into the "model"
                partition, and feeding AFE/WakeNet from audio_in_task.c.
    endchoice

endmenu
```

## firmware/apps/node_limb/main/Kconfig.projbuild
```kconfig
menu "Powersuit node_limb Configuration"

    choice PS_NODE_ID
        prompt "Limb node identity"
        default PS_NODE_IS_ARM_RIGHT
        help
            One firmware image serves Nodes 1-4 (docs/network-map.md section 1
            node registry); this choice selects which bench harness and board
            table (board_limb.h) the build targets. Joints per limb: arms
            elbow=0/wrist=1, legs hip=0/knee=1.

        config PS_NODE_IS_ARM_RIGHT
            bool "arm_right  (node 1, CAN bus 1)"
        config PS_NODE_IS_ARM_LEFT
            bool "arm_left   (node 2, CAN bus 1)"
        config PS_NODE_IS_LEG_RIGHT
            bool "leg_right  (node 3, CAN bus 2)"
        config PS_NODE_IS_LEG_LEFT
            bool "leg_left   (node 4, CAN bus 2)"
    endchoice

    config PS_LIMB_NODE_ID
        int
        default 1 if PS_NODE_IS_ARM_RIGHT
        default 2 if PS_NODE_IS_ARM_LEFT
        default 3 if PS_NODE_IS_LEG_RIGHT
        default 4 if PS_NODE_IS_LEG_LEFT
        help
            Numeric node ID (powersuit_proto/can_id.h PS_NODE_ARM_R..LEG_L),
            used verbatim as the CAN source address and to pick the board
            table / micro-ROS node name in app_main.c.

    config PS_LIMB_BENCH
        bool "Bench mode: no motor driver, encoders or current sense"
        default n
        help
            Runs the real limb firmware on a bare DevKitC-1 with only a CAN
            transceiver attached (docs/bringup.md Appendix A). The motor driver
            (MCPWM), encoder SPI and ADC are not initialised: the joints read as
            at rest with zero current, and joint_write() counts the ticks on
            which the safety gate WOULD have energised a joint instead of driving
            gates. Everything else is the real code: the 1 kHz control loop on
            core 1, PIDs and FOC maths, ps_safety, 100 Hz TELEM on core 0, the
            IMU on I2C (allowed to be absent).

            Needed because board_limb.h's pin map cannot run on this board: it
            assigns GPIO 22-25, which do not exist on the ESP32-S3, and 35-37,
            the octal PSRAM on N16R8 (see the note at the top of board_limb.h).

    config PS_LIMB_BENCH_CAN_TX_GPIO
        int "Bench TWAI TX GPIO"
        depends on PS_LIMB_BENCH
        default 4

    config PS_LIMB_BENCH_CAN_RX_GPIO
        int "Bench TWAI RX GPIO"
        depends on PS_LIMB_BENCH
        default 5

endmenu
```

## firmware/components/ps_can/Kconfig
```kconfig
menu "ps_can (TWAI transport)"

    config PS_CAN_TX_GPIO
        int "Default CAN TX GPIO"
        default 4
        help
            Bench default for the single-controller nodes (1-6). The chest hub
            passes both controllers' pins explicitly from board_hub.h instead.

    config PS_CAN_RX_GPIO
        int "Default CAN RX GPIO"
        default 5

    config PS_CAN_BITRATE
        int "CAN bitrate (bit/s)"
        range 25000 1000000
        default 1000000
        help
            Contract value is 1 Mbps on both buses (docs/network-map.md §2).
            The bus load budget in §10 assumes it; anything lower is a bench
            setting, not a suit setting. Every node on a segment must agree.

            Bench note: the SN65HVD230 modules in docs/bringup.md A.1 run in
            slope-control mode (Rs reported fixed at 10 kOhm, ~15 V/us, ~100 ns
            loop delay). TI specifies the part to 1 Mbps in that mode, and two
            nodes over 20 cm need ~200 ns of a ~750 ns sample point, so 1 Mbps
            is in spec. If bus_errors climb anyway, 250000 is the fallback:
            BENCH_CAN_BITRATE=250000 bash firmware/tools/build_bench.sh

endmenu
```

## firmware/components/ps_spibridge/Kconfig
```kconfig
menu "ps_spibridge (Node 7 SPI slave bridge)"

    comment "GPIO 7/9/10/8 are the ESP32-P4 SPI2 (GPSPI2) IO_MUX pad set (CS0/SCLK/MISO/MOSI)."
    comment "SPI2 is the only slave-capable controller on the P4; IO_MUX routing is required"
    comment "headroom for the 20 MHz qualification point (docs/network-map.md section 12.1)."

    config PS_SPIB_MOSI_GPIO
        int "SPI2 MOSI GPIO"
        range 0 54
        default 8

    config PS_SPIB_MISO_GPIO
        int "SPI2 MISO GPIO"
        range 0 54
        default 10

    config PS_SPIB_SCLK_GPIO
        int "SPI2 SCLK GPIO"
        range 0 54
        default 9

    config PS_SPIB_CS_GPIO
        int "SPI2 CS0 GPIO"
        range 0 54
        default 7

    config PS_SPIB_DATA_READY_GPIO
        int "DATA_READY GPIO (out, high while uplink pending)"
        range 0 54
        default 4

endmenu
```

## firmware/components/ps_uros/Kconfig
```kconfig
menu "ps_uros (micro-ROS over the XRCE CAN plane)"

    config PS_UROS_TASK_STACK
        int "micro-ROS session task stack (bytes)"
        default 16384
        help
            rclc session setup plus the executor needs a generous stack; 16 KB is
            the value micro-ROS examples use for comparable entity counts.

    config PS_UROS_RX_RING
        int "Inbound XRCE stream buffer (bytes)"
        default 2048
        help
            Holds HDLC-framed agent traffic between the CAN receive callback and
            the transport read. Must exceed the XRCE MTU (512) with headroom.

    config PS_UROS_PING_PERIOD_MS
        int "Agent liveness ping period (ms)"
        default 2000

endmenu
```
